## boards/arm/stm3221g_eval/Kconfig.board
```kconfig
# STM32F103RCT6 Mini board configuration

# Copyright (c) 2020 WuhanStudio
# SPDX-License-Identifier: Apache-2.0

config BOARD_STM3221G_EVAL
	bool "STM32F217IG Eval Board"
	depends on SOC_STM32F217XX
```

## boards/arm/stm3221g_eval/Kconfig.defconfig
```kconfig
# STM32F103RCT6 Mini board configuration

# Copyright (c) 2020 WuhanStudio
# SPDX-License-Identifier: Apache-2.0

if BOARD_STM3221G_EVAL

config BOARD
	default "stm3221g_eval"

endif # BOARD_STM3221G_EVAL
```

## boards/arm/stm3221g_eval/stm3221g_eval_defconfig
```kconfig
# SPDX-License-Identifier: Apache-2.0

CONFIG_SOC_SERIES_STM32F2X=y
CONFIG_SOC_STM32F217XX=y
# 72MHz system clock
CONFIG_SYS_CLOCK_HW_CYCLES_PER_SEC=96000000

# enable uart driver
CONFIG_SERIAL=y
# enable console
CONFIG_CONSOLE=y
CONFIG_UART_CONSOLE=y

# enable pinmux
CONFIG_PINMUX=y

# enable GPIO
CONFIG_GPIO=y

# clock configuration
CONFIG_CLOCK_CONTROL=y
CONFIG_PINCTRL=y
# Use the internal 8MHz clock
```
